## boot/coreboot/Config.in
```kconfig
config BR2_TARGET_COREBOOT
	bool "coreboot"
	help
	  Build "coreboot" BIOS ROM

if BR2_TARGET_COREBOOT
choice
	prompt "coreboot Version"
	help
	  Select the specific coreboot version you want to use

config BR2_TARGET_COREBOOT_LATEST_VERSION
	bool "4.5"

config BR2_TARGET_COREBOOT_CUSTOM_VERSION
	bool "Custom version"
	help
	  This option allows to use a specific official versions

config BR2_TARGET_COREBOOT_CUSTOM_TARBALL
	bool "Custom tarball"

config BR2_TARGET_COREBOOT_CUSTOM_GIT
	bool "Custom Git repository"

config BR2_TARGET_COREBOOT_CUSTOM_HG
	bool "Custom Mercurial repository"

config BR2_TARGET_COREBOOT_CUSTOM_SVN
	bool "Custom Subversion repository"

endchoice

config BR2_TARGET_COREBOOT_CUSTOM_VERSION_VALUE
	string "coreboot version"
	depends on BR2_TARGET_COREBOOT_CUSTOM_VERSION

config BR2_TARGET_COREBOOT_CUSTOM_TARBALL_LOCATION
	string "URL of custom coreboot tarball"
	depends on BR2_TARGET_COREBOOT_CUSTOM_TARBALL

if BR2_TARGET_COREBOOT_CUSTOM_GIT || BR2_TARGET_COREBOOT_CUSTOM_HG || BR2_TARGET_COREBOOT_CUSTOM_SVN

config BR2_TARGET_COREBOOT_CUSTOM_REPO_URL
	string "URL of custom repository"
	default BR2_TARGET_COREBOOT_CUSTOM_GIT_REPO_URL \
		if BR2_TARGET_COREBOOT_CUSTOM_GIT_REPO_URL != ""  # legacy

config BR2_TARGET_COREBOOT_CUSTOM_REPO_VERSION
	string "Custom repository version"
	default BR2_TARGET_COREBOOT_CUSTOM_GIT_VERSION \
		if BR2_TARGET_COREBOOT_CUSTOM_GIT_VERSION != ""  # legacy
	help
	  Revision to use in the typical format used by Git/Mercurial/Subversion
	  E.G. a sha id, a tag, branch, ..

endif

config BR2_TARGET_COREBOOT_VERSION
	string
	default "4.5"	if BR2_TARGET_COREBOOT_LATEST_VERSION
	default BR2_TARGET_COREBOOT_CUSTOM_VERSION_VALUE \
		if BR2_TARGET_COREBOOT_CUSTOM_VERSION
	default "custom"	if BR2_TARGET_COREBOOT_CUSTOM_TARBALL
	default BR2_TARGET_COREBOOT_CUSTOM_REPO_VERSION \
		if BR2_TARGET_COREBOOT_CUSTOM_GIT || BR2_TARGET_COREBOOT_CUSTOM_HG || BR2_TARGET_COREBOOT_CUSTOM_SVN

config BR2_TARGET_COREBOOT_PATCH
	string "Custom coreboot patches"
	default BR2_TARGET_COREBOOT_CUSTOM_PATCH_DIR if BR2_TARGET_COREBOOT_CUSTOM_PATCH_DIR != ""  # legacy
	help
	  A space-separated list of patches to apply to coreboot.
	  Each patch can be described as an URL, a local file path,
	  or a directory. In the case of a directory, all files
	  matching *.patch in the directory will be applied.

	  Most users may leave this empty

choice
	prompt "coreboot configuration"
	default BR2_TARGET_COREBOOT_USE_DEFCONFIG

config BR2_TARGET_COREBOOT_USE_DEFCONFIG
	bool "Using an in-tree board defconfig file"

config BR2_TARGET_COREBOOT_USE_CUSTOM_CONFIG
	bool "Using a custom board (def)config file"

endchoice

config BR2_TARGET_COREBOOT_BOARD_DEFCONFIG
	string "Board defconfig"
	depends on BR2_TARGET_COREBOOT_USE_DEFCONFIG
	help
	  Name of the board for which coreboot should be built, without
	  the _defconfig suffix.

config BR2_TARGET_COREBOOT_CUSTOM_CONFIG_FILE
	string "Configuration file path"
	depends on BR2_TARGET_COREBOOT_USE_CUSTOM_CONFIG
	help
	  Path to the coreboot configuration file.

config BR2_TARGET_COREBOOT_LINUX_PAYLOAD
       bool "Include kernel as a payload"
       depends on BR2_LINUX_KERNEL
       help
	Include generated Linux into coreboot.rom

config BR2_TARGET_COREBOOT_LINUX_COMMAND
       string "Kernel command line"
       depends on BR2_TARGET_COREBOOT_LINUX_PAYLOAD
       help
	Include Command line to pass to linux kernel.

config BR2_TARGET_COREBOOT_ROOTFS_PAYLOAD
       bool "Include root filesystem in payload"
       depends on BR2_TARGET_COREBOOT_LINUX_PAYLOAD
       select BR2_TARGET_ROOTFS_CPIO
       help
	Add generated root filesystem to the payload
	
endif # BR2_TARGET_COREBOOT
```

## configs/platina-mk1-bmc_defconfig
```kconfig
BR2_arm=y
BR2_cortex_a9=y
BR2_ARM_ENABLE_NEON=y
BR2_ARM_ENABLE_VFP=y
BR2_ARM_FPU_VFPV3=y
BR2_TOOLCHAIN_BUILDROOT_VENDOR="platina"
BR2_KERNEL_HEADERS_4_9=y
BR2_TOOLCHAIN_BUILDROOT_USE_SSP=y
# BR2_UCLIBC_INSTALL_UTILS is not set
BR2_INIT_PLATINA_GOES=y
# BR2_TARGET_ENABLE_ROOT_LOGIN is not set
BR2_SYSTEM_BIN_SH_NONE=y
# BR2_TARGET_GENERIC_GETTY is not set
BR2_LINUX_KERNEL=y
BR2_LINUX_KERNEL_CUSTOM_GIT=y
BR2_LINUX_KERNEL_CUSTOM_REPO_URL="https://github.com/platinasystems/linux.git"
BR2_LINUX_KERNEL_CUSTOM_REPO_VERSION="master"
BR2_LINUX_KERNEL_DEFCONFIG="platina-mk1-bmc"
BR2_LINUX_KERNEL_DTS_SUPPORT=y
BR2_LINUX_KERNEL_INTREE_DTS_NAME="platina-mk1-bmc"
# BR2_PACKAGE_BUSYBOX is not set
BR2_PACKAGE_E2FSPROGS=y
# BR2_PACKAGE_E2FSPROGS_BADBLOCKS is not set
# BR2_PACKAGE_E2FSPROGS_CHATTR is not set
# BR2_PACKAGE_E2FSPROGS_DUMPE2FS is not set
# BR2_PACKAGE_E2FSPROGS_E2FREEFRAG is not set
# BR2_PACKAGE_E2FSPROGS_E2LABEL is not set
# BR2_PACKAGE_E2FSPROGS_E2UNDO is not set
# BR2_PACKAGE_E2FSPROGS_FILEFRAG is not set
# BR2_PACKAGE_E2FSPROGS_LOGSAVE is not set
# BR2_PACKAGE_E2FSPROGS_LSATTR is not set
# BR2_PACKAGE_E2FSPROGS_MKLOSTFOUND is not set
# BR2_PACKAGE_E2FSPROGS_TUNE2FS is not set
# BR2_PACKAGE_E2FSPROGS_UUIDGEN is not set
BR2_PACKAGE_PLATINA_GOES_MK1_BMC=y
BR2_TARGET_ROOTFS_CPIO=y
BR2_TARGET_ROOTFS_CPIO_XZ=y
# BR2_TARGET_ROOTFS_TAR is not set
BR2_TARGET_UBOOT=y
BR2_TARGET_UBOOT_BOARDNAME="platinamx6boards_qspi"
BR2_TARGET_UBOOT_CUSTOM_GIT=y
BR2_TARGET_UBOOT_CUSTOM_REPO_URL="https://github.com/platinasystems/u-boot.git"
BR2_TARGET_UBOOT_CUSTOM_REPO_VERSION="platina"
```

## configs/platina-mk1_SB_defconfig
```kconfig
BR2_x86_64=y
BR2_x86_corei7_avx=y
BR2_TOOLCHAIN_BUILDROOT_VENDOR="platina"
BR2_TOOLCHAIN_BUILDROOT_USE_SSP=y
# BR2_UCLIBC_INSTALL_UTILS is not set
BR2_INIT_NONE=y
BR2_ROOTFS_POST_BUILD_SCRIPT="../../scripts/buildroot.sh"
# BR2_PACKAGE_BUSYBOX is not set
BR2_PACKAGE_E2FSPROGS=y
# BR2_PACKAGE_E2FSPROGS_BADBLOCKS is not set
# BR2_PACKAGE_E2FSPROGS_CHATTR is not set
# BR2_PACKAGE_E2FSPROGS_DUMPE2FS is not set
# BR2_PACKAGE_E2FSPROGS_E2FREEFRAG is not set
# BR2_PACKAGE_E2FSPROGS_E2LABEL is not set
# BR2_PACKAGE_E2FSPROGS_E2UNDO is not set
# BR2_PACKAGE_E2FSPROGS_FILEFRAG is not set
# BR2_PACKAGE_E2FSPROGS_LOGSAVE is not set
# BR2_PACKAGE_E2FSPROGS_LSATTR is not set
# BR2_PACKAGE_E2FSPROGS_MKLOSTFOUND is not set
# BR2_PACKAGE_E2FSPROGS_TUNE2FS is not set
# BR2_PACKAGE_E2FSPROGS_UUIDGEN is not set
BR2_PACKAGE_FLASHROM=y
BR2_PACKAGE_POPT=y
BR2_TARGET_ROOTFS_CPIO=y
BR2_TARGET_ROOTFS_CPIO_XZ=y
# BR2_TARGET_ROOTFS_TAR is not set
```

## configs/platina-mk1_defconfig
```kconfig
BR2_x86_64=y
BR2_x86_corei7_avx=y
BR2_TOOLCHAIN_BUILDROOT_VENDOR="platina"
BR2_KERNEL_HEADERS_4_9=y
BR2_TOOLCHAIN_BUILDROOT_USE_SSP=y
# BR2_UCLIBC_INSTALL_UTILS is not set
BR2_ROOTFS_SKELETON_NONE=y
BR2_INIT_PLATINA_GOES=y
BR2_ROOTFS_DEVICE_TABLE=""
BR2_LINUX_KERNEL=y
BR2_LINUX_KERNEL_CUSTOM_GIT=y
BR2_LINUX_KERNEL_CUSTOM_REPO_URL="https://github.com/platinasystems/linux"
BR2_LINUX_KERNEL_CUSTOM_REPO_VERSION="master"
BR2_LINUX_KERNEL_DEFCONFIG="platina-mk1"
BR2_LINUX_KERNEL_XZ=y
# BR2_LINUX_KERNEL_INSTALL_TARGET_MODULES is not set
# BR2_PACKAGE_BUSYBOX is not set
BR2_PACKAGE_E2FSPROGS=y
# BR2_PACKAGE_E2FSPROGS_BADBLOCKS is not set
# BR2_PACKAGE_E2FSPROGS_CHATTR is not set
# BR2_PACKAGE_E2FSPROGS_DUMPE2FS is not set
# BR2_PACKAGE_E2FSPROGS_E2FREEFRAG is not set
# BR2_PACKAGE_E2FSPROGS_E2LABEL is not set
# BR2_PACKAGE_E2FSPROGS_E2UNDO is not set
# BR2_PACKAGE_E2FSPROGS_FILEFRAG is not set
# BR2_PACKAGE_E2FSPROGS_LOGSAVE is not set
# BR2_PACKAGE_E2FSPROGS_LSATTR is not set
# BR2_PACKAGE_E2FSPROGS_MKLOSTFOUND is not set
# BR2_PACKAGE_E2FSPROGS_TUNE2FS is not set
# BR2_PACKAGE_E2FSPROGS_UUIDGEN is not set
BR2_PACKAGE_FLASHROM=y
BR2_PACKAGE_POPT=y
BR2_PACKAGE_PLATINA_GOES_TAGS="netgo debug"
BR2_TARGET_ROOTFS_CPIO_XZ=y
# BR2_TARGET_ROOTFS_TAR is not set
BR2_TARGET_COREBOOT=y
BR2_TARGET_COREBOOT_CUSTOM_GIT=y
BR2_TARGET_COREBOOT_CUSTOM_REPO_URL="https://github.com/platinasystems/coreboot.git"
BR2_TARGET_COREBOOT_CUSTOM_REPO_VERSION="buildroot"
BR2_TARGET_COREBOOT_PATCH=""
BR2_TARGET_COREBOOT_BOARD_DEFCONFIG="platina-mk1"
BR2_TARGET_COREBOOT_LINUX_PAYLOAD=y
BR2_TARGET_COREBOOT_LINUX_COMMAND="console=ttyS0,115200 loglevel=4 goesroot=auto:10"
BR2_TARGET_COREBOOT_ROOTFS_PAYLOAD=y
```

## package/cdebootstrap/Config.in
```kconfig
config BR2_PACKAGE_CDEBOOTSTRAP
	bool "cdebootstrap"
	select BR2_PACKAGE_DEBIAN_ARCHIVE_KEYRING
	select BR2_PACKAGE_LIBCURL
	select BR2_PACKAGE_LIBDEBIAN_INSTALLER
	select BR2_PACKAGE_ZLIB
	select BR2_PACKAGE_BZIP2
	select BR2_PACKAGE_XZ
	help
	  cdebootstrap generates systems from scratch for Debian and
	  derivates.

	  https://packages.debian.org/cdebootstrap
```

## package/debian-archive-keyring/Config.in
```kconfig
config BR2_PACKAGE_DEBIAN_ARCHIVE_KEYRING
	bool "debian-archive-keyring"
	select BR2_PACKAGE_HOST_JETRING
	help
	  debian-archive-keyring contains the gpg keys used to
	  authenticate Debian releases.
```

## package/debootstrap/Config.in
```kconfig
config BR2_PACKAGE_DEBOOTSTRAP
	bool "debootstrap"
	select BR2_PACKAGE_DEBIAN_ARCHIVE_KEYRING
	depends on BR2_PACKAGE_BUSYBOX
	depends on BR2_PACKAGE_PERL
	help
	  debootstrap generates systems from scratch for Debian and
	  derivates.

	  https://packages.debian.org/debootstrap
```

## package/jetring/Config.in.host
```kconfig
config BR2_PACKAGE_HOST_JETRING
       bool "host jetring"
       select BR2_PACKAGE_HOST_GNUPG
       help
          jetring is a collection of tools that allow for gpg ketrings
	  to be maintained using changesets. It was developed with the
	  Debian keyring in mind, and aims to solve the problem that a
	  gpg keyring is a binary blob that's hard for multiple people
	  to collaboratively edit.
```

## package/platina-fe1/Config.in
```kconfig
config BR2_PACKAGE_PLATINA_FE1
	bool "platina-fe1"
	depends on BR2_PACKAGE_HOST_GO_ARCH_SUPPORTS
	depends on BR2_PACKAGE_HOST_GO_CGO_LINKING_SUPPORTS
	depends on BR2_TOOLCHAIN_HAS_THREADS
	help
	  platina-fe1 is a library for BCM Tomahawk switches

	  https://github.com/platinasystems/fe1

comment "platina-fe1 needs a toolchain w/ threads"
	depends on BR2_PACKAGE_HOST_GO_ARCH_SUPPORTS
	depends on BR2_PACKAGE_HOST_GO_CGO_LINKING_SUPPORTS
	depends on !BR2_TOOLCHAIN_HAS_THREADS
```

## package/platina-goes/Config.in
```kconfig
config BR2_PACKAGE_PLATINA_GOES
	bool "platina-goes"
	depends on BR2_PACKAGE_HOST_GO_ARCH_SUPPORTS
	depends on BR2_PACKAGE_HOST_GO_CGO_LINKING_SUPPORTS
	depends on BR2_TOOLCHAIN_HAS_THREADS
	help
	  platina-goes is a framework for embedded systems in Go

	  https://github.com/platinasystems/go

comment "platina-goes needs a toolchain w/ threads"
	depends on BR2_PACKAGE_HOST_GO_ARCH_SUPPORTS
	depends on BR2_PACKAGE_HOST_GO_CGO_LINKING_SUPPORTS
	depends on !BR2_TOOLCHAIN_HAS_THREADS

if BR2_PACKAGE_PLATINA_GOES

choice
	bool "goes variant to build"
	default BR2_PACKAGE_PLATINA_GOES_EXAMPLE if BR2_x86_64
	default BR2_PACKAGE_PLATINA_GOES_EXAMPLE_ARM if BR2_arm
	help
	 Pick the variant of goes you want to build for your hardware
	 configuration.

config BR2_PACKAGE_PLATINA_GOES_EXAMPLE
	bool "goes-example"
	depends on BR2_x86_64
	help
	 Example for x86_64 with qemu.

config BR2_PACKAGE_PLATINA_GOES_EXAMPLE_ARM
       bool "goes-example-arm"
       depends on BR2_arm
       help
	Example for ARM with qemu.

config BR2_PACKAGE_PLATINA_GOES_MK1_BMC
       bool "goes-platina-mk1-bmc"
       depends on BR2_arm
       help
	Example for ARM-based BMC on Platina-MK1

config BR2_PACKAGE_PLATINA_GOES_MK1
       bool "goes-platina-mk1"
       depends on BR2_x86_64
       select BR2_PACKAGE_PLATINA_FE1
       help
	Example for Platina-MK1

config BR2_PACKAGE_PLATINA_GOES_COREBOOT
       bool "goes-coreboot"
       depends on BR2_x86_64
       help
	Go-ES based chain loader based on kexec() syscall.

endchoice

config BR2_PACKAGE_PLATINA_GOES_TAGS
       string "Go build tags"
       default "netgo" if BR2_arm
       default "uio_pci_dma foxy" if BR2_PACKAGE_PLATINA_GOES_MK1
       help
	Set the desired go build tags. Read the source code to
	see what these are.
endif
```

## package/ubuntu-keyring/Config.in
```kconfig
config BR2_PACKAGE_UBUNTU_KEYRING
	bool "ubuntu-keyring"
	help
	  ubuntu-keyring contains the gpg keys used to
	  authenticate Ubuntu releases.
```
